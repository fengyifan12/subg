## Kconfig
```kconfig
mainmenu "Rafael SDK Configuration"
osource "${APPLICATION_SOURCE_DIR}/VERSION"
menu "-------- SDK   Configuration --------"
endmenu
source "config/devices.config"

if (RT581 || RT582 || RT583 || RT584H ||  RT584HA4 ||  RF1301 || RT584L)
choice APPLICATION_EXAMPLES_TYPE
	prompt "Select Application"
	default BASIC_EXAMPLE

config HELLOWORLD
	bool "hellow-world"
	select BUILD_COMPONENT_LOG
    select BUILD_COMPONENT_RT569
    select BUILD_COMPONENT_RUCI
    select BUILD_COMPONENT_UART_STDIO
    select BUILD_COMPONENT_UTILITY

config BASIC_EXAMPLE
	bool "Basic peripheral"

config BLUETOOTH_LE_EXAMPLE
	bool "Bluetooth"
	
config THREAD_EXAMPLE
	bool "Thread"

config SUBG_EXAMPLE
	bool "Sub-G"

config ZIGBEE_EXAMPLE
	bool "Zigbee"

config RF_EV_15P4
	bool "RF-ev-15p4"

config HCI_RAW
	bool "Hci-Raw"

config MULTI_PROTOCOL_RCP
	bool "Multi-Rcp"
	select BUILD_COMPONENT_OPENTHREAD
    select BUILD_COMPONENT_ENHANCED_FLASH_DATASET
    select BUILD_COMPONENT_CLI
    select BUILD_COMPONENT_LOG
    select BUILD_COMPONENT_CPC
    select BUILD_COMPONENT_BLUETOOTH
    select BUILD_COMPONENT_BLUETOOTH_HCI_BRIDGE
    select BUILD_COMPONENT_LMAC5P4
    select BUILD_COMPONENT_UART_STDIO
    select BUILD_COMPONENT_UTILITY

config RF_EV_UB
	bool "RF-ev-ub"
	select BUILD_COMPONENT_CSS
    select BUILD_COMPONENT_LOG
    select BUILD_COMPONENT_RT569
    select BUILD_COMPONENT_RUCI
    select BUILD_COMPONENT_UART_STDIO
    select BUILD_COMPONENT_UTILITY

config RF_LABTEST_TOOL
	bool "RF-labtest-tool"
	select BUILD_COMPONENT_CSS
    select BUILD_COMPONENT_LOG
    select BUILD_COMPONENT_RT569
    select BUILD_COMPONENT_RUCI
    select BUILD_COMPONENT_UART_STDIO
    select BUILD_COMPONENT_UTILITY


if BASIC_EXAMPLE
source "config/examples/basic_examples.config"
endif

if BLUETOOTH_LE_EXAMPLE
source "config/examples/ble_example.config"
source "config/components/network/bluetooth/ble.config"
endif

if THREAD_EXAMPLE 
source "config/examples/thread_examples.config"
source "config/components/network/thread/thread.config"
endif

if SUBG_EXAMPLE 
source "config/examples/sub-g_examples.config"
source "config/components/network/subg_ctrl/subg_ctrl.config"
endif

if ZIGBEE_EXAMPLE 
source "config/examples/zigbee_examples.config"
source "config/components/network/zigbee/zigbee.config"
endif

if RF_EV_UB 
source "examples/rf-ev-ub/Kconfig"
endif

if RF_LABTEST_TOOL 
source "examples/rf-labtest-tool/Kconfig"
endif

if HCI_RAW 
source "examples/hci_raw/Kconfig"
endif

if MULTI_PROTOCOL_RCP
source "examples/multi-rcp/Kconfig"
source "config/components/network/bluetooth/ble.config"
source "config/components/network/thread/thread.config"
source "config/components/network/zigbee/zigbee.config"
endif

if RF_EV_15P4 
source "examples/rf-ev-15p4/Kconfig"
endif

if HELLOWORLD 
source "examples/helloworld/Kconfig"
endif
endchoice
endif


if RT582_NONE_OS || RT584H_NONE_OS || RT584L_NONE_OS || RF1301_NONE_OS || RT584HA4_NONE_OS

choice APPLICATION_EXAMPLES_TYPE
	prompt "Select Application"
	default BOOTLOADER_APP

config BOOTLOADER_APP
	bool "bootlader"

if BOOTLOADER_APP
source "examples/bootloader-app/Kconfig"
endif

endchoice
endif

source "config/platform.config"
source "config/components/cpc/cpc.config"
source "config/components/network/rf/rf.config"
source "config/components/network/rt569-rf/rt569-rf.config"

source "config/components/platform/crypto/crypto.config"
source "config/components/utility/utility.config"
source "config/build_project.config"
source "config/compilier.config"
```

## config/components/utility/Kconfig
```kconfig
menu "UTLITY"

menu "UART Console"
config UART_STDIO_PORT
    int "UART stdio port"
	def_int 0
    help
        UART stdio port

config UART_STDIO_TX_PIN
    int "UART stdio tx pin"
    def_int 17
    range 0 32

config UART_STDIO_RX_PIN
    int "UART stdio rx pin"
    def_int 16
    range 0 32

config UART_STDIO_BAUDRATE
    int "UART stdio baudrate"
	def_int 2000000
    help
        UART stdio baudrate
endmenu

menu "Sofware timer"

config SW_TIMER_ENABLE_DEBUG
    bool "Enable debug log"
	def_bool false
endmenu

config LOG_MAX_LEVEL
    int "log level (debug: 0, info: 1, warn: 2, error: 3)"
	def_int 1
        

endmenu
```

## examples/sub-g/mesh-it-up/miu-radar/Kconfig
```kconfig
menu "PROJECT CONFIG"

config APP_TASK_STACK_SIZE
    int "Application task stack size"
    range 256 4096
    default 2048

config APP_TASK_PRIORITY
    int "Application task priority"
    range 10 30
    default 15

config RADAR_UART1_TX_PIN
    int "Radar sensor UART1 TX pin number"
    range 0 31
    default 28
    help
      GPIO pin used as UART1 TX to communicate with the radar sensor.
      Default 28 matches the RF1301-EVB header.

config RADAR_UART1_RX_PIN
    int "Radar sensor UART1 RX pin number"
    range 0 31
    default 29
    help
      GPIO pin used as UART1 RX to communicate with the radar sensor.
      Default 29 matches the RF1301-EVB header.

config RADAR_PRESENCE_GPIO_PIN
    int "Radar presence detect GPIO pin number"
    range 0 31
    default 30
    help
      GPIO pin used to detect radar presence output.
      High level reports presence=1, low level reports presence=0.

endmenu
```
