# RT584ZCM33 register map
Series: ARMv8-M Mainline; File version: 1.0
ARM 32-bit Cortex-M33 based device.
CPU: CM33 r0p0, little endian, MPU, no FPU, VTOR, 3 interrupt priority bits
Registers are 32-bit, read-write, reset 0x0 unless marked. A register's access mark holds for its fields unless they carry their own. Offsets are from the block's base; lines under a group give offsets from that group; [hi:lo] are bit positions; {n}, {i} and the like mark numbered series; 'fields as' and 'values as' point back to an identical list; <NAME> marks a mode.

## Memory map
0x40000000 SYS_CTRL_Non-Secure size 0x1000 — SYS_CTRL Non-Secure Register block
0x40001000 GPIO_Non-Secure size 0x1000 — GPIO Non-Secure Register block
0x40004000 RTC_Non-Secure size 0x1000 — RTC Non-Secure Register block
0x40005000 DPD_Non-Secure size 0x1000 — DPD Non-Secure Register block
0x40009000 FLASH_CONTROL_Non-Secure size 0x1000 — FLASH_CONTROL Non-Secure Register block
0x4000A000 TIMER0_Non-Secure size 0x1000 — TIMER0 Non-Secure Register block
0x4000B000 TIMER1_Non-Secure size 0x1000 — TIMER1 Non-Secure Register block
0x4000C000 TIMER2_Non-Secure size 0x1000 — TIMER2 Non-Secure Register block
0x4000D000 TIMER32K0_Non-Secure size 0x1000 — TIMER32K0 Non-Secure Register block
0x4000E000 TIMER32K1_Non-Secure size 0x1000 — TIMER32K1 Non-Secure Register block
0x40010000 WDT_Non-Secure size 0x1000 — WDT Non-Secure Register block
0x40012000 UART0_Non-Secure size 0x1000 — UART0 Non-Secure Register block
0x40013000 UART1_Non-Secure size 0x1000 — UART1 Non-Secure Register block
0x40018000 I2C_S_Non-Secure size 0x1000 — I2C_S Non-Secure Register block
0x4001A000 Comm_Non-Secure size 0x1000 — Comm Non-Secure Register block
0x4001D000 BOD_COMP_Non-Secure size 0x1000 — BOD_COMP Non-Secure Register block
0x4001E000 AUX_COMP_Non-Secure size 0x1000 — AUX_COMP Non-Secure Register block
0x40020000 QSPI0_Non-Secure size 0x1000 — QSPI0 Non-Secure Register block
0x40021000 QSPI1_Non-Secure size 0x1000 — QSPI1 Non-Secure Register block
0x40024000 IRM_Non-Secure size 0x1000 — IRM Non-Secure Register block
0x40025000 UART2_Non-Secure size 0x1000 — UART2 Non-Secure Register block
0x40026000 PWM0_Non-Secure size 0x100 — PWM0 Non-Secure Register block
0x40026100 PWM1_Non-Secure size 0x100 — PWM1 Non-Secure Register block
0x40026200 PWM2_Non-Secure size 0x100 — PWM2 Non-Secure Register block
0x40026300 PWM3_Non-Secure size 0x100 — PWM3 Non-Secure Register block
0x40026400 PWM4_Non-Secure size 0x100 — PWM4 Non-Secure Register block
0x40028000 xDMA_Non-Secure size 0x1000 — xDMA Non-Secure Register block
0x40029000 DMA0_Non-Secure size 0x1000 — DMA0 Non-Secure Register block
0x4002A000 DMA1_Non-Secure size 0x1000 — DMA1 Non-Secure Register block
0x4002B000 I2C_M0_Non-Secure size 0x1000 — I2C_M0 Non-Secure Register block
0x4002C000 I2C_M1_Non-Secure size 0x1000 — I2C_M1 Non-Secure Register block
0x4002D000 I2S0_M_Non-Secure size 0x1000 — I2S0_M Non-Secure Register block
0x4002F000 SADC_Non-Secure size 0x1000 — SADC Non-Secure Register block
0x40030000 SWIRQ0_Non-Secure size 0x1000 — SWIRQ0 Non-Secure Register block
0x40031000 SWIRQ1_Non-Secure size 0x1000 — SWIRQ1 Non-Secure Register block
0x50000000 SYS_CTRL_Secure size 0x1000 — SYS_CTRL Secure Register block
0x50001000 GPIO_Secure size 0x1000 — GPIO Secure Register block
0x50003000 SEC_CTRL_Secure size 0x1000 — SEC_CTRL Secure Register block
0x50004000 RTC_Secure size 0x1000 — RTC Secure Register block
0x50005000 DPD_Secure size 0x1000 — DPD Secure Register block
0x50009000 FLASH_CONTROL_Secure size 0x1000 — FLASH_CONTROL Secure Register block
0x5000A000 TIMER0_Secure size 0x1000 — TIMER0 Secure Register block
0x5000B000 TIMER1_Secure size 0x1000 — TIMER1 Secure Register block
0x5000C000 TIMER2_Secure size 0x1000 — TIMER2 Secure Register block
0x5000D000 TIMER32K0_Secure size 0x1000 — TIMER32K0 Secure Register block
0x5000E000 TIMER32K1_Secure size 0x1000 — TIMER32K1 Secure Register block
0x50010000 WDT_Secure size 0x1000 — WDT Secure Register block
0x50012000 UART0_Secure size 0x1000 — UART0 Secure Register block
0x50013000 UART1_Secure size 0x1000 — UART1 Secure Register block
0x50018000 I2C_S_Secure size 0x1000 — I2C_S Secure Register block
0x5001A000 Comm_Secure size 0x1000 — Comm Secure Register block
0x5001D000 BOD_COMP_Secure size 0x1000 — BOD_COMP Secure Register block
0x5001E000 AUX_COMP_Secure size 0x1000 — AUX_COMP Secure Register block
0x50020000 QSPI0_Secure size 0x1000 — QSPI0 Secure Register block
0x50021000 QSPI1_Secure size 0x1000 — QSPI1 Secure Register block
0x50024000 IRM_Secure size 0x1000 — IRM Secure Register block
0x50025000 UART2_Secure size 0x1000 — UART2 Secure Register block
0x50026000 PWM0_Secure size 0x100 — PWM0 Secure Register block
0x50026100 PWM1_Secure size 0x100 — PWM1 Secure Register block
0x50026200 PWM2_Secure size 0x100 — PWM2 Secure Register block
0x50026300 PWM3_Secure size 0x100 — PWM3 Secure Register block
0x50026400 PWM4_Secure size 0x100 — PWM4 Secure Register block
0x50028000 xDMA_Secure size 0x1000 — xDMA Secure Register block
0x50029000 DMA0_Secure size 0x1000 — DMA0 Secure Register block
0x5002A000 DMA1_Secure size 0x1000 — DMA1 Secure Register block
0x5002B000 I2C_M0_Secure size 0x1000 — I2C_M0 Secure Register block
0x5002C000 I2C_M1_Secure size 0x1000 — I2C_M1 Secure Register block
0x5002D000 I2S0_M_Secure size 0x1000 — I2S0_M Secure Register block
0x5002F000 SADC_Secure size 0x1000 — SADC Secure Register block
0x50030000 SWIRQ0_Secure size 0x1000 — SWIRQ0 Secure Register block
0x50031000 SWIRQ1_Secure size 0x1000 — SWIRQ1 Secure Register block
0x60000000 CRYPTO_Non-Secure size 0x4000 — CRYPTO Non-Secure Register block
0x70000000 CRYPTO_Secure size 0x4000 — CRYPTO Secure Register block

## Interrupts
0 GPIO (GPIO_Non-Secure, GPIO_Secure) — GPIO interrupt
1 TIMER0 (TIMER0_Non-Secure, TIMER0_Secure) — TIMER0 interrupt
2 TIMER1 (TIMER1_Non-Secure, TIMER1_Secure) — TIMER1 interrupt
3 TIMER2 (TIMER2_Non-Secure, TIMER2_Secure) — TIMER2 interrupt
4 TIMER32K0 (TIMER32K0_Non-Secure, TIMER32K0_Secure) — TIMER32K0 interrupt
5 TIMER32K1 (TIMER32K1_Non-Secure, TIMER32K1_Secure) — TIMER32K1 interrupt
6 WDT (WDT_Non-Secure, WDT_Secure) — WDT interrupt
7 RTC (RTC_Non-Secure, RTC_Secure) — RTC interrupt
9 SWIRQ0 (SWIRQ0_Non-Secure, SWIRQ0_Secure) — SWIRQ0 interrupt
10 SWIRQ1 (SWIRQ1_Non-Secure, SWIRQ1_Secure) — SWIRQ1 interrupt
12 DMA0 (DMA0_Non-Secure, DMA0_Secure) — DMA0 interrupt
13 DMA1 (DMA1_Non-Secure, DMA1_Secure) — DMA1 interrupt
16 UART0 (UART0_Non-Secure, UART0_Secure) — UART0 interrupt
17 UART1 (UART1_Non-Secure, UART1_Secure) — UART1 interrupt
18 UART2 (UART2_Non-Secure, UART2_Secure) — UART2 interrupt
20 IRM (IRM_Non-Secure, IRM_Secure) — IRM interrupt
21 I2C_M0 (I2C_M0_Non-Secure, I2C_M0_Secure) — I2C_M0 interrupt
22 I2C_M1 (I2C_M1_Non-Secure, I2C_M1_Secure) — I2C_M1 interrupt
23 I2C_S (I2C_S_Non-Secure, I2C_S_Secure) — I2C_S interrupt
25 QSPI0 (QSPI0_Non-Secure, QSPI0_Secure) — QSPI0 interrupt
26 QSPI1 (QSPI1_Non-Secure, QSPI1_Secure) — QSPI1 interrupt
29 I2S0_M (I2S0_M_Non-Secure, I2S0_M_Secure) — I2S0_M interrupt
32 PWM0 (PWM0_Non-Secure, PWM0_Secure) — PWM0 interrupt
33 PWM1 (PWM1_Non-Secure, PWM1_Secure) — PWM1 interrupt
34 PWM2 (PWM2_Non-Secure, PWM2_Secure) — PWM2 interrupt
35 PWM3 (PWM3_Non-Secure, PWM3_Secure) — PWM3 interrupt
36 PWM4 (PWM4_Non-Secure, PWM4_Secure) — PWM4 interrupt
39 FLASH_CONTROL (FLASH_CONTROL_Non-Secure, FLASH_CONTROL_Secure) — FLASH_CONTROL interrupt
41 CRYPTO (CRYPTO_Non-Secure, CRYPTO_Secure) — CRYPTO interrupt
42 BOD_COMP (BOD_COMP_Non-Secure, BOD_COMP_Secure) — BOD_COMP interrupt
44 SEC_CTRL (SEC_CTRL_Secure) — SEC_CTRL interrupt
46 SADC (SADC_Non-Secure, SADC_Secure) — SADC interrupt
47 AUX_COMP (AUX_COMP_Non-Secure, AUX_COMP_Secure) — AUX_COMP interrupt

## Notices in the file
Copyright (C) 2012 - 2018 Arm Limited. All rights reserved.
Purpose: System Viewer Description (SVD) Example (Schema Version 1.1)
This is a description of a none-existent and incomplete device
for demonstration purposes only.
Redistribution and use in source and binary forms, with or without
modification, are permitted provided that the following conditions are met:
- Redistributions of source code must retain the above copyright
notice, this list of conditions and the following disclaimer.
- Redistributions in binary form must reproduce the above copyright
notice, this list of conditions and the following disclaimer in the
documentation and/or other materials provided with the distribution.
- Neither the name of ARM nor the names of its contributors may be used
to endorse or promote products derived from this software without
specific prior written permission.
THIS SOFTWARE IS PROVIDED BY THE COPYRIGHT HOLDERS AND CONTRIBUTORS "AS IS"
AND ANY EXPRESS OR IMPLIED WARRANTIES, INCLUDING, BUT NOT LIMITED TO, THE
IMPLIED WARRANTIES OF MERCHANTABILITY AND FITNESS FOR A PARTICULAR PURPOSE
ARE DISCLAIMED. IN NO EVENT SHALL COPYRIGHT HOLDERS AND CONTRIBUTORS BE
LIABLE FOR ANY DIRECT, INDIRECT, INCIDENTAL, SPECIAL, EXEMPLARY, OR
CONSEQUENTIAL DAMAGES (INCLUDING, BUT NOT LIMITED TO, PROCUREMENT OF
SUBSTITUTE GOODS OR SERVICES; LOSS OF USE, DATA, OR PROFITS; OR BUSINESS
INTERRUPTION) HOWEVER CAUSED AND ON ANY THEORY OF LIABILITY, WHETHER IN
CONTRACT, STRICT LIABILITY, OR TORT (INCLUDING NEGLIGENCE OR OTHERWISE)
ARISING IN ANY WAY OUT OF THE USE OF THIS SOFTWARE, EVEN IF ADVISED OF THE
POSSIBILITY OF SUCH DAMAGE.
