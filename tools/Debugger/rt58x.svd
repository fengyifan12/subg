# RT58X register map
Series: ARMv8-M Mainline; File version: 1.0
ARM 32-bit Cortex-M3 based device.
CPU: CM3 r0p0, little endian, MPU, no FPU, VTOR, 3 interrupt priority bits
Registers are 32-bit, read-write, reset 0x0 unless marked. A register's access mark holds for its fields unless they carry their own. Offsets are from the block's base; lines under a group give offsets from that group; [hi:lo] are bit positions; {n}, {i} and the like mark numbered series; 'fields as' and 'values as' point back to an identical list; <NAME> marks a mode.

## Memory map
0x40000000 GPIO size 0x100000 — GPIO Register block
0x40200000 RT570_PMU size 0x100000 — RT570_PMU Register block
0x40500000 REMAP size 0x100000 — REMAP Register block
0x40600000 RTC size 0x100000 — RTC Register block
0x40800000 SYS_CTRL size 0x100000 — SYS_CTRL Register block
0xA0000000 UART0 size 0x100000 — UART0 Register block
0xA0100000 I2C_M size 0x100000 — I2C_M Register block
0xA0200000 CACHECTRL size 0x100000 — CACHECTRL Register block
0xA0300000 FLASH_CONTROL size 0x100000 — FLASH_CONTROL Register block
0xA0400000 RT569_AHB size 0x100000 — RT569_AHB Register block
0xA0500000 UART1 size 0x100000 — UART1 Register block
0xA0600000 UART2 size 0x100000 — UART2 Register block
0xA0700000 TIMER0 size 0x100000 — TIMER0 Register block
0xA0800000 TIMER1 size 0x100000 — TIMER1 Register block
0xA0900000 WDT size 0x100000 — WDT Register block
0xA0A00000 I2S0_MS size 0x100000 — I2S0_MS Register block
0xA0B00000 XDMA size 0x100000 — XDMA Register block
0xA0C00000 PWM size 0x100000 — PWM Register block
0xA0D00000 SADC size 0x100000 — SADC Register block
0xA0E00000 CRYPTO size 0x100000 — CRYPTO Register block
0xA0F00000 TIMER2 size 0x40000 — TIMER2 Register block
0xA0F40000 TIMER3 size 0x40000 — TIMER3 Register block
0xA0F80000 TIMER4 size 0x80000 — TIMER4 Register block
0xB0000000 QSPI0 size 0x10000000 — QSPI0 Register block
0xC0000000 DMA0 size 0x10000000 — DMA0 Register block

## GPIO — GPIO Register block
Base 0x40000000
0x00 SET_STATE_REG — Write 1 to each bit sets the corresponding output signal.
0x04 CLR_INTR_REG — Write 1 to each bit clears the corresponding output signal.
0x08 OUT_REG reset 0xFFFFFFFF — Each bit that is set to 1 configures the corresponding signal as an output. All signals default to inputs.
0x0C IN_REG wo reset 0xFFFFFFFF — Each bit that is set to 1 configures the corresponding signal as an input.
0x10 INTR_EN_REG — Each bit that is set to 1 enables an interrupt for the corresponding signal.
0x14 INTR_DIS_REG wo — Each bit that is set to 1 disables an interrupt for the corresponding signal.
0x18 INTR_EDGE_REG — Each bit that is set to 1 indicates that the interrupt has been set to edge-sensitive.
0x1C INTR_LEVEL_REG — Each bit that is set to 1 indicates that the interrupt has been set to level-sensitive.
0x20 INTR_HIGH_REG — Write 1's to set interrupts to active high or rising edge.
0x24 INTR_LOW_REG wo — Write 1's to set interrupts to active low or falling edge.
0x28 INTR_ANYEDGE_SET_REG — Write 1's to override interrupt edge selection & instead interrupt on ANY edge.
0x2C INTR_ANYEDGE_CLR_REG wo — Write 1's to clear edge sensitive override.
0x30 INTR_EDGE_CLR_REG wo — Write 1's to clear edge sensitive interrupts.
0x38 INHIBIT_IN_REG — Each bit that is set to 1 inhibits the corresponding input signal. Read for current state of all active low output enable signals. All inputs default to enabled.
0x3C ALLOW_IN_REG wo — Each bit that is set to 1 allows/enables the corresponding input signal. Read for current state of all active low output enable signals. All inputs default to enabled.
0x40 DEB_EN_REG — Each bit that is set to 1 enables the de-bounce for the corresponding signal.
0x44 DEB_DIS_REG wo — Each bit that is set to 1 disables the de-bounce for the corresponding signal.
0x48 DEB_SEL_REG — deb sel
  [2:0] DEB_SEL — De-bounce time selection 0: 32 slow clocks 1: 64 slow clocks 2: 128 slow clocks 3: 256 slow clocks 4: 512 slow clocks 5: 1024 slow clocks 6: 2048 slow clocks 7: 4096 slow clocks
    0=B_0_to_2_ITEM0 (32 slow clocks); 1=B_0_to_2_ITEM1 (64 slow clocks); 2=B_0_to_2_ITEM2 (128 slow clocks); 3=B_0_to_2_ITEM3 (256 slow clocks); 4=B_0_to_2_ITEM4 (512 slow clocks); 5=B_0_to_2_ITEM5 (1024 slow clocks); 6=B_0_to_2_ITEM6 (2048 slow clocks); 7=B_0_to_2_ITEM7 (4096 slow clocks)

## Notices in the file
Copyright (C) 2012 - 2018 Arm Limited. All rights reserved.
Purpose: System Viewer Description (SVD) Example (Schema Version 1.1)
This is a description of a none-existent and incomplete device
for demonstration purposes only.
Redistribution and use in source and binary forms, with or without
modification, are permitted provided that the following conditions are met:
- Redistributions of source code must retain the above copyright
notice, this list of conditions and the following disclaimer.
- Redistributions in binary form must reproduce the above copyright
notice, this list of conditions and the following disclaimer in the
documentation and/or other materials provided with the distribution.
- Neither the name of ARM nor the names of its contributors may be used
to endorse or promote products derived from this software without
specific prior written permission.
THIS SOFTWARE IS PROVIDED BY THE COPYRIGHT HOLDERS AND CONTRIBUTORS "AS IS"
AND ANY EXPRESS OR IMPLIED WARRANTIES, INCLUDING, BUT NOT LIMITED TO, THE
IMPLIED WARRANTIES OF MERCHANTABILITY AND FITNESS FOR A PARTICULAR PURPOSE
ARE DISCLAIMED. IN NO EVENT SHALL COPYRIGHT HOLDERS AND CONTRIBUTORS BE
LIABLE FOR ANY DIRECT, INDIRECT, INCIDENTAL, SPECIAL, EXEMPLARY, OR
CONSEQUENTIAL DAMAGES (INCLUDING, BUT NOT LIMITED TO, PROCUREMENT OF
SUBSTITUTE GOODS OR SERVICES; LOSS OF USE, DATA, OR PROFITS; OR BUSINESS
INTERRUPTION) HOWEVER CAUSED AND ON ANY THEORY OF LIABILITY, WHETHER IN
CONTRACT, STRICT LIABILITY, OR TORT (INCLUDING NEGLIGENCE OR OTHERWISE)
ARISING IN ANY WAY OUT OF THE USE OF THIS SOFTWARE, EVEN IF ADVISED OF THE
POSSIBILITY OF SUCH DAMAGE.
